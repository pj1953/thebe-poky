## build/conf/bblayers.conf
```bitbake
# LAYER_CONF_VERSION is increased each time build/conf/bblayers.conf
# changes incompatibly
LCONF_VERSION = "6"

BBPATH = "${TOPDIR}"
BBFILES ?= ""

OVEN = "${@os.path.realpath('../..')}"
BBLAYERS_NON_REMOVABLE ?= " \
  ${OVEN}/poky/meta \
  ${OVEN}poky/meta-yocto \
  "
#added by hob
BBFILES += "${TOPDIR}/recipes/images/custom/*.bb"
#added by hob
BBFILES += "${TOPDIR}/recipes/images/*.bb"

#added by hob (and top alien)

BBLAYERS = "\
         ${OVEN}/poky/meta \
         ${OVEN}/poky/meta-yocto \
         ${OVEN}/poky/meta-yocto-bsp \
         ${OVEN}/meta-openembedded/meta-networking \
         ${OVEN}/meta-openembedded/meta-oe \
         ${OVEN}/meta-openembedded/meta-python \
         ${OVEN}/meta-openembedded/meta-webserver \
         "
```

## meta/conf/machine/hughes-acadia-arm.conf
```bitbake
#@TYPE: Acadia
#@NAME: hughes_acadia_arm_cortex_a9
#@DESCRIPTION: hughes_acadia_arm_cortex_a9
DEFAULTTUNE ?= "armv7a"

require conf/machine/include/qemu.inc
require conf/machine/include/tune-cortexa9.inc

KERNEL_IMAGETYPE = "zImage"

SERIAL_CONSOLE = "115200 ttyAMA0"
```
